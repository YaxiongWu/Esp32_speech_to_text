## baidu_speech_to_text/main/Kconfig.projbuild
```kconfig
menu "Example Configuration"

config WIFI_SSID
    string "WiFi SSID"
	default "myssid"
	help
		SSID (network name) for the example to connect to.

config WIFI_PASSWORD
    string "WiFi Password"
	default "mypassword"
	help
		WiFi password (WPA or WPA2) for the example to use.
		Can be left blank if the network has no security set.

config BAIDU_ACCESS_KEY
    string "Baidu Access Key"
    default "access key"
    help
        Baidu Cloud API Key

        The key may be obtained from https://cloud.baidu.com/

config BAIDU_SECRET_KEY
    string "Baidu Cloud Secret Key"
    default "baidu secret key"
    help
        Baidu cloud secret key

        The key may be obtained from https://cloud.baidu.com/


endmenu
```

## xunfei_speech_to_text/main/Kconfig.projbuild
```kconfig
menu "Example Configuration"

config WIFI_SSID
    string "WiFi SSID"
	default "myssid"
	help
		SSID (network name) for the example to connect to.

config WIFI_PASSWORD
    string "WiFi Password"
	default "mypassword"
	help
		WiFi password (WPA or WPA2) for the example to use.
		Can be left blank if the network has no security set.

config Xunfei_APPID
    string "Xunfei APPID"
    default "APPID"
    help
        Xunfei APPID

        The APPID be obtained from https://www.xfyun.cn

config Xunfei_APISecret
    string "Xunfei APISecret"
    default "APISecret"
    help
        Xunfei APISecret

        The APISecret be obtained from https://www.xfyun.cn

config Xunfei_APIKey
    string "Xunfei APIKey"
    default "APIKey"
    help
        Xunfei APIKey

        The APIKey be obtained from https://www.xfyun.cn

endmenu
```
